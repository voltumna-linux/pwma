## conf/layer.conf
```bitbake
# We have a conf and classes directory, add to BBPATH
BBPATH .= ":${LAYERDIR}"

# We have recipes-* directories, add to BBFILES
BBFILES += "${LAYERDIR}/recipes-*/*/*.bb ${LAYERDIR}/recipes-*/*/*.bbappend"

BBFILE_COLLECTIONS += "pwma"
BBFILE_PATTERN_pwma = "^${LAYERDIR}/"
BBFILE_PRIORITY_pwma = "11"

# This should only be incremented on significant changes that will
# cause compatibility issues with other layers
LAYERVERSION_pwma = "1"

LAYERDEPENDS_pwma = "core"

LAYERSERIES_COMPAT_pwma = "dunfell"
```
